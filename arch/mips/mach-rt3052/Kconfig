## arch/mips/mach-rt3052/Kconfig
```kconfig
menu "Ralink RT305x platforms"
	depends on ARCH_RALINK

config SYS_MALLOC_F_LEN
	default 0x1000

config SYS_SOC
	default "rt3052"

config SYS_DCACHE_SIZE
	default 16384

config SYS_DCACHE_LINE_SIZE
	default 32

config SYS_ICACHE_SIZE
	default 32768

config SYS_ICACHE_LINE_SIZE
	default 32

config TEXT_BASE
	default 0x9f000000 if !BOARD_DIR620

config BUILD_TARGET
	default "u-boot.bin" if !BOARD_DIR620

config MAX_MEM_SIZE
	int
	default 64

choice
	prompt "Board select"

config BOARD_DUMMY
	bool "Dummy board (test only)"
	help
	  Placeholder board option used to test Kconfig choice handling.

config BOARD_DIR620
	bool "D-Link DIR-620 A1"
	select CFI_FLASH
	select CFI_FLASH_USE_WEAK_ACCESSORS
	select DM_RESET
	select DM_MTD
	select FLASH_CFI_DRIVER
	select MTD
	select MTD_NOR_FLASH
	select OF_CONTROL
	select RESET_RALINK_SYSC
	select DM
	select DM_SERIAL
	select RT3050_ETH
	help
	  D-Link DIR-620 A1 board based on Ralink RT3052 SoC.
	  32 MiB SDRAM, 8 MiB parallel NOR flash, USB.

endchoice

source "board/d-link/dir-620/Kconfig"

endmenu
```

## board/d-link/dir-620/Kconfig
```kconfig
if BOARD_DIR620

config SYS_BOARD
	default "dir-620"

config SUPPORT_SPL
	def_bool y

config SYS_VENDOR
	default "d-link"

config SYS_CONFIG_NAME
	default "dir-620"

config ENV_IS_IN_FLASH
	def_bool y

config USE_IPADDR
	def_bool y

config IPADDR
	default "10.10.10.123"

config USE_SERVERIP
	def_bool y

config SERVERIP
	default "10.10.10.3"

#
# Boot profile selection
#

choice DIR620_PROFILE
	prompt "DIR-620 profile"
	default DIR620_PROFILE_TEST

config DIR620_PROFILE_PROD
	bool "Production profile"
	help
	  Boot flow:
	    CPU reset vector -> 0xbfc00000 (alias to flash base)
	    -> SPL runs XIP from flash at 0x9f000000/0xbf000000
	    -> SPL initialises DRAM, reads DTB+U-Boot LZMA from flash
	    -> SPL decompresses U-Boot to RAM at 0x80200000, jumps to it
	    -> U-Boot starts, reads kernel from flash, boots it
	    The image is written at flash offset 0x0 (standalone).

config DIR620_PROFILE_TEST
	bool "Test profile"
	help
	  Boot flow:
	    Proprietary bootloader at flash offset 0x0 starts
	    -> run SPL: go 0xbf050000
	    -> SPL runs XIP from flash at 0xbf050000 (KSEG1 uncached)
	    -> SPL initialises DRAM, reads DTB+U-Boot LZMA from flash
	    -> SPL decompresses U-Boot to RAM at 0x80200000, jumps to it
	    -> U-Boot starts, reads kernel from flash, boots it
	    The image is written at flash offset 0x50000 (after proprietary
	    bootloader).  Proprietary bootloader at offset 0x0 is preserved
	    — power-cycle to recover from a bad SPL.

config DIR620_PROFILE_RAM
	bool "RAM debug profile"
	help
	  Boot flow:
	    Load the full flash image into RAM at $loadaddr
	    -> run SPL from RAM with 'go $loadaddr'
	    -> SPL initialises DRAM, reads DTB+U-Boot LZMA from RAM
	    -> SPL decompresses U-Boot to RAM at 0x80200000, jumps to it
	    -> U-Boot starts, old flash contents are untouched

endchoice

config DIR620_FLASH_DIRECT
	bool "Direct memory-mapped CFI command transport"
	default y
	help
	  Use the standard U-Boot CFI command transport, writing flash
	  command cycles directly to the KSEG1 NOR flash window. This is
	  the default.


#
# Common layout
#

config DIR620_DTB_OFFSET
	hex "DIR620_DTB_OFFSET"
	default 0x8000
	help
	  Offset of the device tree blob within the flash image.

config DIR620_DTB_MAX_SIZE
	hex "DIR620_DTB_MAX_SIZE"
	default 0x1980
	help
	  Maximum size allocated for the device tree blob in flash.

config DIR620_UBOOT_PART_END
	hex
	default 0x30000
	help
	  End boundary of the U-Boot partition in flash.

config DIR620_FIRMWARE_OFFSET
	hex
	default 0x30000 if DIR620_PROFILE_PROD
	default 0x80000 if DIR620_PROFILE_TEST || DIR620_PROFILE_RAM
	help
	  Flash offset of the OpenWrt firmware partition.

config DIR620_FIRMWARE_SIZE
	hex
	default 0x7d0000 if DIR620_PROFILE_PROD
	default 0x780000 if DIR620_PROFILE_TEST || DIR620_PROFILE_RAM
	help
	  Size of the OpenWrt firmware partition.

config DIR620_FW_BASE
	hex
	default 0xbf030000 if DIR620_PROFILE_PROD
	default 0xbf080000 if DIR620_PROFILE_TEST || DIR620_PROFILE_RAM
	help
	  KSEG1 flash address passed to bootm for the OpenWrt uImage.

config DIR620_FLASH_DTB_ADDR
	hex
	default 0xbf008000 if DIR620_PROFILE_PROD
	default 0xbf058000 if DIR620_PROFILE_TEST || DIR620_PROFILE_RAM
	help
	  KSEG1 flash address of the U-Boot DTB embedded in the flash image.

config SPL_MAX_SIZE
	default 0x5E00

config SPL_PAD_TO
	default 0x10000

config SPL_BSS_START_ADDR
	default 0x80010000

config SPL_BSS_MAX_SIZE
	default 0x10000

config SPL_PAYLOAD
	default "u-boot-lzma.img" if SPL_LZMA

config ENV_SIZE
	default 0x2000

# common for both
config TEXT_BASE
	default 0x80200000

config DIR620_EXCEPTION_RECOVERY
	hex "Exception recovery target address"
	default 0xbf050000
	help
	  MIPS exception vectors (TLB refill, general exception, etc.)
	  jump to this KSEG1 address instead of halting.
	  Defaults to 0xbf050000 — the TEST SPL XIP address at flash
	  offset 0x50000.  On PROD this gives a recovery path: any
	  exception falls through to the test bootloader.
	  Set to 0 to keep the standard halt-on-exception behavior.

config CMD_BOOTMENU
	default y

config BOOTMENU_ANSI
	default n


#
# Profile-dependent layout
#

config SPL_TEXT_BASE
	default 0x9f000000 if DIR620_PROFILE_PROD
	default 0x9f050000 if DIR620_PROFILE_TEST
	default 0xa0800000 if DIR620_PROFILE_RAM

# Protect command for U-Boot partition sectors (SPL+DTB+LZMA).
# PROD must skip 8KB env sector at 0x6000; TEST has env outside the region.
config LOCK_UBOOT_PART_CMD
	string
	default "protect on 0xbf000000 +0x6000 && protect on 0xbf008000 +0x28000" if DIR620_PROFILE_PROD
	default "protect on 0xbf050000 +0x30000" if DIR620_PROFILE_TEST || DIR620_PROFILE_RAM

config ENV_ADDR
	default 0xbf006000 if DIR620_PROFILE_PROD
	default 0xbf030000 if DIR620_PROFILE_TEST || DIR620_PROFILE_RAM

config ENV_SECT_SIZE
	default 0x2000 if DIR620_PROFILE_PROD
	default 0x10000 if DIR620_PROFILE_TEST || DIR620_PROFILE_RAM

config BUILD_TARGET
    default "u-boot-dir620-flash.bin" if DIR620_PROFILE_PROD
    default "u-boot-dir620-test-flash.bin" if DIR620_PROFILE_TEST || DIR620_PROFILE_RAM

endif
```

## board/mediatek/mt7628/TPLINK_WA801ND_V5/Kconfig
```kconfig
if BOARD_TPLINK_WA801ND_V5

config SYS_BOARD
	default "mt7628"

config SYS_VENDOR
	default "mediatek"

config SYS_CONFIG_NAME
	default "mt7628"

endif
```

## configs/dir-620_defconfig
```kconfig
CONFIG_MIPS=y
CONFIG_SYS_MALLOC_LEN=0x1000000
CONFIG_SPL_LIBCOMMON_SUPPORT=y
CONFIG_SPL_LIBGENERIC_SUPPORT=y
CONFIG_NR_DRAM_BANKS=1
CONFIG_DM_GPIO=y
CONFIG_DEFAULT_DEVICE_TREE="dlink_dir-620-a1"
CONFIG_SPL_SYS_MALLOC_F_LEN=0x40000
CONFIG_SPL_SERIAL=y
CONFIG_SYS_LOAD_ADDR=0x80800000
CONFIG_SPL=y
CONFIG_DEBUG_UART_BASE=0xb0000c00
CONFIG_DEBUG_UART_CLOCK=0
CONFIG_ARCH_RALINK=y
CONFIG_BOARD_DIR620=y
CONFIG_SYS_MIPS_TIMER_FREQ=160000000
CONFIG_RESTORE_EXCEPTION_VECTOR_BASE=y
CONFIG_MIPS_BOOT_FDT=y
CONFIG_DEBUG_UART=y
CONFIG_ENV_VARS_UBOOT_CONFIG=y
CONFIG_SYS_BOOT_GET_CMDLINE=y
CONFIG_SYS_BOOT_GET_KBD=y
CONFIG_OF_STDOUT_VIA_ALIAS=y
CONFIG_SYS_CBSIZE=512
CONFIG_SYS_PBSIZE=532
CONFIG_LOGLEVEL=6
# CONFIG_DISPLAY_BOARDINFO is not set
CONFIG_DISPLAY_BOARDINFO_LATE=y
CONFIG_MISC_INIT_R=y
CONFIG_SYS_MALLOC_BOOTPARAMS=y
CONFIG_SPL_BOARD_INIT=y
CONFIG_SPL_SYS_MALLOC_SIMPLE=y
CONFIG_SPL_NOR_SUPPORT=y
CONFIG_HUSH_PARSER=y
# CONFIG_BOOTM_PLAN9 is not set
# CONFIG_BOOTM_RTEMS is not set
# CONFIG_BOOTM_VXWORKS is not set
# CONFIG_CMD_ELF is not set
# CONFIG_CMD_XIMG is not set
CONFIG_CMD_GREPENV=y
CONFIG_CMD_ENV_FLAGS=y
CONFIG_CMD_NVEDIT_INFO=y
CONFIG_CMD_NVEDIT_LOAD=y
CONFIG_CMD_NVEDIT_SELECT=y
CONFIG_CMD_ENDIAN=y
CONFIG_CMD_BINOP=y
# CONFIG_CMD_CRC32 is not set
CONFIG_LOOPW=y
CONFIG_CMD_MD5SUM=y
CONFIG_MD5SUM_VERIFY=y
CONFIG_CMD_MEMINFO=y
CONFIG_CMD_MEM_SEARCH=y
CONFIG_CMD_SHA1SUM=y
CONFIG_SHA1SUM_VERIFY=y
CONFIG_CMD_STRINGS=y
CONFIG_CMD_LZMADEC=y
CONFIG_CMD_PART=y
CONFIG_CMD_USB=y
CONFIG_CMD_XXD=y
CONFIG_CMD_WOL=y
CONFIG_CMD_DHCP=y
CONFIG_CMD_MII=y
CONFIG_CMD_PING=y
CONFIG_CMD_PXE=y
CONFIG_CMD_CLS=y
CONFIG_CMD_SYSBOOT=y
CONFIG_CMD_EXT4=y
CONFIG_CMD_FS_GENERIC=y
# CONFIG_SPL_DOS_PARTITION is not set
# CONFIG_ISO_PARTITION is not set
CONFIG_EFI_PARTITION=y
# CONFIG_SPL_EFI_PARTITION is not set
CONFIG_OF_INITIAL_DTB_READONLY=y
CONFIG_OF_BOARD=y
CONFIG_VERSION_VARIABLE=y
CONFIG_NET_RANDOM_ETHADDR=y
CONFIG_SPL_DM=y
# CONFIG_SPL_BLK is not set
CONFIG_LED=y
CONFIG_LED_BOOT=y
CONFIG_LED_GPIO=y
CONFIG_SYS_FLASH_CFI_WIDTH_16BIT=y
CONFIG_FLASH_SHOW_PROGRESS=0
CONFIG_BAUDRATE=57600
CONFIG_SPECIFY_CONSOLE_INDEX=y
CONFIG_RT305X_UART=y
CONFIG_USB=y
CONFIG_USB_DWC2=y
CONFIG_USB_STORAGE=y
# CONFIG_GZIP is not set
CONFIG_SPL_LZMA=y
# CONFIG_VPL_LZMA is not set
CONFIG_HEXDUMP=y
CONFIG_SPL_OF_LIBFDT=y
```

## configs/tplink_wa801nd_v5_defconfig
```kconfig
CONFIG_MIPS=y
CONFIG_SKIP_LOWLEVEL_INIT=y
CONFIG_SYS_MALLOC_LEN=0x100000
CONFIG_SPL_LIBCOMMON_SUPPORT=y
CONFIG_SPL_LIBGENERIC_SUPPORT=y
CONFIG_NR_DRAM_BANKS=1
CONFIG_ENV_SIZE=0x1000
CONFIG_ENV_OFFSET=0x1F000
CONFIG_ENV_SECT_SIZE=0x1000
CONFIG_DEFAULT_DEVICE_TREE="tplink,tl-wa801nd-v5"
CONFIG_SPL_SERIAL=y
CONFIG_SPL_SYS_MALLOC_F_LEN=0x40000
CONFIG_SPL_BSS_START_ADDR=0x80010000
CONFIG_SPL_BSS_MAX_SIZE=0x10000
CONFIG_SYS_BOOTM_LEN=0x1000000
CONFIG_SYS_LOAD_ADDR=0x80010000
CONFIG_SPL=y
CONFIG_ARCH_MTMIPS=y
CONFIG_SOC_MT7628=y
CONFIG_BOARD_TPLINK_WA801ND_V5=y
CONFIG_SYS_MIPS_TIMER_FREQ=290000000
CONFIG_MIPS_CACHE_SETUP=y
CONFIG_MIPS_CACHE_DISABLE=y
CONFIG_RESTORE_EXCEPTION_VECTOR_BASE=y
CONFIG_MIPS_BOOT_FDT=y
CONFIG_AUTOBOOT_MENU_SHOW=y
# CONFIG_ARCH_FIXUP_FDT_MEMORY is not set
CONFIG_SYS_CONSOLE_INFO_QUIET=y
CONFIG_BOARD_LATE_INIT=y
CONFIG_SYS_MALLOC_BOOTPARAMS=y
CONFIG_SPL_MAX_SIZE=0x10000
CONFIG_SPL_SYS_MALLOC_SIMPLE=y
CONFIG_SPL_NOR_SUPPORT=y
# CONFIG_AUTO_COMPLETE is not set
CONFIG_CMD_HISTORY=y
# CONFIG_CMD_BOOTD is not set
CONFIG_CMD_BOOTZ=y
# CONFIG_BOOTM_NETBSD is not set
# CONFIG_BOOTM_PLAN9 is not set
# CONFIG_BOOTM_RTEMS is not set
# CONFIG_BOOTM_VXWORKS is not set
CONFIG_CMD_BOOTMENU=y
# CONFIG_CMD_ELF is not set
# CONFIG_CMD_XIMG is not set
# CONFIG_CMD_EXPORTENV is not set
# CONFIG_CMD_IMPORTENV is not set
# CONFIG_CMD_EDITENV is not set
CONFIG_CMD_NVEDIT_INFO=y
CONFIG_CMD_ENDIAN=y
CONFIG_CMD_BINOP=y
CONFIG_CMD_MEMINFO=y
CONFIG_CMD_MEMINFO_MAP=y
CONFIG_CMD_MEM_SEARCH=y
# CONFIG_CMD_RANDOM is not set
CONFIG_CMD_MEMTEST=y
CONFIG_CMD_LZMADEC=y
CONFIG_CMD_UNLZ4=y
# CONFIG_CMD_DM is not set
CONFIG_CMD_GPIO=y
# CONFIG_CMD_LOADS is not set
CONFIG_CMD_SPI=y
CONFIG_CMD_XXD=y
# CONFIG_BOOTP_DNS is not set
# CONFIG_BOOTP_HOSTNAME is not set
CONFIG_CMD_WOL=y
CONFIG_CMD_DHCP=y
CONFIG_CMD_MII=y
CONFIG_CMD_PING=y
CONFIG_CMD_PAUSE=y
CONFIG_CMD_HASH=y
CONFIG_HASH_VERIFY=y
# CONFIG_ISO_PARTITION is not set
CONFIG_ENV_IS_IN_SPI_FLASH=y
CONFIG_ENV_RELOC_GD_ENV_ADDR=y
CONFIG_USE_BOOTFILE=y
CONFIG_BOOTFILE="tftpboot.bin"
CONFIG_NET_RANDOM_ETHADDR=y
# CONFIG_INPUT is not set
# CONFIG_SPI_FLASH_SMART_HWCAPS is not set
# CONFIG_SPI_FLASH_LOCK is not set
# CONFIG_SPI_FLASH_UNLOCK_ALL is not set
CONFIG_SPI_FLASH_GIGADEVICE=y
CONFIG_MT7628_ETH=y
CONFIG_SPI=y
CONFIG_MT7621_SPI=y
# CONFIG_REGEX is not set
# CONFIG_GZIP is not set
CONFIG_SPL_LZMA=y
```

## drivers/bus/Kconfig
```kconfig
# SPDX-License-Identifier: GPL-2.0
#
# Bus Devices
#

menu "Bus devices"

config PALMBUS
	bool "Ralink/Mediatek palmbus driver"
	depends on DM
	default y if ARCH_RALINK
	help
	  Support for the Ralink/Mediatek palmbus, an internal peripheral bus
	  found on RT305x/RT335x/MT7620/MT7628 SoCs. This bus provides
	  memory-mapped access to SoC subsystems.

config SPL_PALMBUS
	bool "Ralink/Mediatek palmbus driver (SPL)"
	depends on SPL_DM
	help
	  Support for the Ralink/Mediatek palmbus in SPL.

config TPL_PALMBUS
	bool "Ralink/Mediatek palmbus driver (TPL)"
	depends on TPL_DM

config TI_PWMSS
	bool
	default y if ARCH_OMAP2PLUS && PWM_TI_EHRPWM
	help
	  PWM Subsystem driver support for AM33xx SOC.

config TI_SYSC
	bool "TI sysc interconnect target module driver"
	depends on DM && ARCH_OMAP2PLUS
	select CLK
	help
	  Generic driver for Texas Instruments interconnect target module
	  found on many TI SoCs.

config SPL_TI_SYSC
	bool "Support TI sysc interconnect in SPL"
	depends on SPL_DM && TI_SYSC
	help
	  Generic driver for Texas Instruments interconnect target module
	  found on many TI SoCs.

config UNIPHIER_SYSTEM_BUS
	bool "UniPhier System Bus driver"
	depends on ARCH_UNIPHIER
	default y
	help
	  Support for UniPhier System Bus, a simple external bus.  This is
	  needed to use on-board devices connected to UniPhier SoCs.

endmenu
```
